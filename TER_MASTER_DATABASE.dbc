VERSION ""

NS_ :

BS_:
BU_: TER_PEDAL
BO_ 1 APPS: 0 TER_PEDAL
   SG_ APPS_1 : 7|8@0+ (1,0) [0|255] "" Vector__XXX
   SG_ APPS_2 : 15|8@0+ (1,0) [0|255] "" Vector__XXX
   SG_ IMP_FLAGS : 23|8@0+ (1,0) [0|255] "" Vector__XXX

BA_DEF_ BO_ "GenMsgBackgroundColor" STRING ;
BA_DEF_ BO_ "GenMsgForegroundColor" STRING ;
BA_DEF_ BO_ "filterlabeling" INT 0 0;
BA_DEF_DEF_ "GenMsgBackgroundColor" "#ffffff";
BA_DEF_DEF_ "GenMsgForegroundColor" "#000000";
BA_DEF_DEF_ "filterlabeling" 1;
CM_ BU_ TER_PEDAL "APPS,BPPS, Implausabilities...";
CM_ BO_ 1 "Accelerator Pedal Position Sensor and Implausability";
VAL_ 1 APPS_1 0 "No Description";
